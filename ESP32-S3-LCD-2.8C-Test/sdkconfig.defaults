## ESP32-S3-LCD-2.8C-Test/sdkconfig.defaults
```kconfig
CONFIG_LV_MEM_CUSTOM=y
CONFIG_LV_MEMCPY_MEMSET_STD=y
CONFIG_LV_USE_USER_DATA=y
CONFIG_LV_USE_CHART=y
# CONFIG_LV_USE_PERF_MONITOR is not set

CONFIG_ESPTOOLPY_FLASHSIZE_16MB=y
CONFIG_PARTITION_TABLE_CUSTOM=y
CONFIG_BOOTLOADER_APP_ROLLBACK_ENABLE=y
CONFIG_APP_ROLLBACK_ENABLE=y

CONFIG_ESP32S3_DATA_CACHE_LINE_64B=y
CONFIG_ESP32S3_DATA_CACHE_LINE_SIZE=64

CONFIG_ESP32S3_DEFAULT_CPU_FREQ_240=y
CONFIG_ESP32S3_DEFAULT_CPU_FREQ_MHZ=240
CONFIG_COMPILER_OPTIMIZATION_PERF=y

CONFIG_FREERTOS_HZ=1000
CONFIG_ESP_INT_WDT_TIMEOUT_MS=10000
CONFIG_INT_WDT_TIMEOUT_MS=10000
CONFIG_ESP_TASK_WDT_TIMEOUT_S=15
CONFIG_TASK_WDT_TIMEOUT_S=15
# CONFIG_ESP_TASK_WDT_CHECK_IDLE_TASK_CPU0 is not set
# CONFIG_ESP_TASK_WDT_CHECK_IDLE_TASK_CPU1 is not set
# CONFIG_TASK_WDT_CHECK_IDLE_TASK_CPU0 is not set
# CONFIG_TASK_WDT_CHECK_IDLE_TASK_CPU1 is not set
CONFIG_ESP_SYSTEM_EVENT_QUEUE_SIZE=64
CONFIG_SYSTEM_EVENT_QUEUE_SIZE=64
CONFIG_EXAMPLE_DOUBLE_FB=y
# CONFIG_EXAMPLE_USE_BOUNCE_BUFFER is not set
# CONFIG_EXAMPLE_AVOID_TEAR_EFFECT_WITH_SEM is not set

# CONFIG_BT_ENABLED is not set

# CONFIG_SPI_FLASH_AUTO_SUSPEND is not set
CONFIG_LWIP_SO_RCVBUF=y

# --- WiFi RX throughput tuning ---
CONFIG_ESP_WIFI_STATIC_RX_BUFFER_NUM=16
# --- lwIP TCP throughput tuning ---
CONFIG_LWIP_TCPIP_RECVMBOX_SIZE=64
CONFIG_LWIP_TCP_RECVMBOX_SIZE=64
CONFIG_LWIP_WND_SCALE=y

# --- HTTP server ---
CONFIG_HTTPD_MAX_REQ_HDR_LEN=1024
CONFIG_HTTPD_SERVER_EVENT_POST_TIMEOUT=200
```
